#include <SPI.h>
#include <TinyScreen.h>
#include <Wire.h>
#include <stdlib.h>
#include <math.h>
#define VAR_DECLS
#include "pokemon.h"

#define ALPHA 0xFE
#define DEX_SIZE 5

TinyScreen display = TinyScreen(TinyScreenDefault);

const unsigned char POKEBALL_XY[2] PROGMEM = {12, 13};
const unsigned char POKEBALL_0[156] PROGMEM = {ALPHA, ALPHA, ALPHA, ALPHA, 0, 0, 0, 0, ALPHA, ALPHA, ALPHA, ALPHA, ALPHA, ALPHA, 0, 0, 75, 38, 38, 38, 0, 0, ALPHA, ALPHA, ALPHA, 0, 75, 75, 75, 75, 38, 38, 38, 38, 0, ALPHA, ALPHA, 0, 75, 255, 75, 75, 75, 75, 38, 38, 0, ALPHA, 0, 75, 255, 255, 255, 75, 75, 75, 75, 38, 38, 0,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 0, ALPHA, 0, 255, 255, 255, 0, 0, 255, 255, 255, 0, ALPHA, ALPHA, 0, 255, 255, 255, 255, 255, 255, 255, 255, 0, ALPHA, ALPHA, ALPHA, 0, 0, 255, 255, 255, 255, 0, 0, ALPHA, ALPHA, ALPHA, ALPHA, ALPHA, ALPHA, 0, 0, 0, 0, ALPHA, ALPHA, ALPHA, ALPHA};

const unsigned char PLATFORM_0_XY[2] PROGMEM = {10, 10};
const unsigned char PLATFORM_1_XY[2] PROGMEM = {10, 10};
const unsigned char PLATFORM_0[100] PROGMEM = {9, 9, 9, 9, 9, 9, 9, 9, 9, 9, 14, 10, 10,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 9, 9};
const unsigned char PLATFORM_1[100] PROGMEM = {9, 9, 9, 9, 9, 9, 9, 9, 9, 9, 14, 14, 9,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 9, 9};
const unsigned char * const PLATFORM_ARR[4] PROGMEM = {PLATFORM_0, PLATFORM_0_XY, PLATFORM_1, PLATFORM_1_XY};

const unsigned char BEAUTIFLY_0_XY[2] PROGMEM = {22, 22};
const unsigned char BEAUTIFLY_1_XY[2] PROGMEM = {22, 22};
const unsigned char BEAUTIFLY_0[484] PROGMEM = {255, 255, 255, 255, 255, 255, 255, 255, 255, 255, 255, 255, 255,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 255, 255};
const unsigned char BEAUTIFLY_1[484] PROGMEM = {255, 255, 255, 255, 255, 255, 255, 255, 255, 255, 255, 255, 255,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 255, 255};

const unsigned char AGGRON_0_XY[2] PROGMEM = {29, 29};
const unsigned char AGGRON_0[841] PROGMEM = {255, 255, 255, 255, 255, 255, 255, 255, 255, 255, 255, 255, 255,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 255, 255};
const unsigned char AGGRON_1_XY[2] PROGMEM = {29, 29};
const unsigned char AGGRON_1[841] PROGMEM = {255, 255, 255, 255, 255, 255, 255, 255, 255, 255, 255, 255, 255,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 255, 255};

const unsigned char CRAWDAUNT_0_XY[2] PROGMEM = {24, 24};
const unsigned char CRAWDAUNT_0[576] PROGMEM = {255, 255, 255, 255, 255, 255, 255, 255, 255, 255, 255, 255, 255,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 255, 255};
const unsigned char CRAWDAUNT_1_XY[2] PROGMEM = {24, 24};
const unsigned char CRAWDAUNT_1[576] PROGMEM = {255, 255, 255, 255, 255, 255, 255, 255, 255, 255, 255, 255, 255,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 255, 255};

const unsigned char METAGROSS_0_XY[2] PROGMEM = {25, 25};
const unsigned char METAGROSS_0[625] PROGMEM = {255, 255, 255, 255, 255, 255, 72, 72, 72, 255, 255, 255, 255,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 255, 255};
const unsigned char METAGROSS_1_XY[2] PROGMEM = {25, 25};
const unsigned char METAGROSS_1[625] PROGMEM = {255, 255, 255, 255, 255, 72, 72, 72, 255, 255, 255, 255, 255,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 255, 255};

const unsigned char MILOTIC_0_XY[2] PROGMEM = {27, 27};
const unsigned char MILOTIC_0[729] PROGMEM = {255, 255, 255, 255, 255, 255, 255, 255, 255, 255, 255, 255, 255,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 255, 255};
const unsigned char MILOTIC_1_XY[2] PROGMEM = {27, 27};
const unsigned char MILOTIC_1[729] PROGMEM = {255, 255, 255, 255, 255, 255, 255, 255, 255, 255, 255, 255, 255,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 255, 255};

const unsigned char * const POKEMON_ARR[4*DEX_SIZE] PROGMEM = {BEAUTIFLY_0, BEAUTIFLY_0_XY, BEAUTIFLY_1, BEAUTIFLY_1_XY, AGGRON_0, AGGRON_0_XY, AGGRON_1, AGGRON_1_XY, CRAWDAUNT_0, CRAWDAUNT_0_XY, CRAWDAUNT_1, CRAWDAUNT_1_XY, METAGROSS_0, METAGROSS_0_XY, METAGROSS_1, METAGROSS_1_XY, MILOTIC_0, MILOTIC_0_XY, MILOTIC_1, MILOTIC_1_XY};
const char * const POKENAME[DEX_SIZE] = {"Beautifly", "Aggron", "Crawdaunt", "Metagross", "Milotic"};

const unsigned char SPRITE_XY[2] PROGMEM = {56, 56};
const unsigned char SPRITE_0[3136] PROGMEM = {4, 4, 2, 2, 2, 34, 34, 34, 34, 34, 34, 39, 39,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 4, ALPHA, 4, 39, 34, 2, 4, ALPHA, ALPHA, 4, 4, 4, ALPHA, 4, 4, 4, ALPHA, ALPHA, 4, 4, 4, 4, ALPHA, ALPHA, 4, 4, 4, ALPHA, 4, 4, 4, 4, ALPHA, 4, 4, 4, ALPHA, ALPHA, 4, 4, 4, 4, ALPHA, ALPHA, 4, 4, 4, ALPHA, 4, 4, 4, ALPHA, ALPHA, 4, 4, 4, ALPHA, ALPHA, ALPHA, 4, 4, 4, ALPHA};

void setup() {
  Wire.begin();
  display.begin();
  display.setBrightness(15);
  Serial.begin(9600);
  randomSeed(analogRead(0));
}

void loop() {
  unsigned char randNumber = random(DEX_SIZE);
  char * pokename = POKENAME[randNumber];
  ITEM_POINTER head = NULL;
  int spriteX = -6;
  int curtainX = -14;
  unsigned char i = 0;
  AddStage(&head);
  addItem(48, 38, (PGM_P)POKEBALL_XY, (PGM_P)POKEBALL_0, 0, 1, &head);
  addItem(curtainX, 28, (PGM_P)SPRITE_XY, (PGM_P)SPRITE_0, 0, 0, &head);
  addItem(Rx-curtainX, 28, (PGM_P)SPRITE_XY, (PGM_P)SPRITE_0, 0, 1, &head);
  DrawScreen(&head);
  freeList(&head);
  display.setFont(thinPixel7_10ptFontInfo);
  display.fontColor(TS_8b_Black,TS_8b_White);
  display.setCursor(48 - (display.getPrintWidth("Who's that") / 2), 10 - (display.getFontHeight() / 2));
  display.print("Who's that");
  display.setCursor(48 - (display.getPrintWidth("pokemon") / 2), 20 - (display.getFontHeight() / 2));
  display.print("pokemon");
  
  GetInput();
  
  while (spriteX != 48){
    spriteX += 2;
    AddStage(&head);
    addItem(spriteX, 28, (PGM_P)pgm_read_word(&(POKEMON_ARR[4*randNumber + 2*i+1])), (PGM_P)pgm_read_word(&(POKEMON_ARR[4*randNumber + 2*i])), 1, 1, &head);
    addItem(curtainX, 28, (PGM_P)SPRITE_XY, (PGM_P)SPRITE_0, 0, 0, &head);
    addItem(Rx-curtainX, 28, (PGM_P)SPRITE_XY, (PGM_P)SPRITE_0, 0, 1, &head);
    DrawScreen(&head);
    freeList(&head);
    i = generator(i);
    delay(200);
  }
  spriteX = 48;
  while (curtainX != Rx/2 - 56/2 + 2){
    AddStage(&head);
    addItem(spriteX, 28, (PGM_P)pgm_read_word(&(POKEMON_ARR[4*randNumber + 2*i+1])), (PGM_P)pgm_read_word(&(POKEMON_ARR[4*randNumber + 2*i])), 1, 1, &head);
    addItem(curtainX, 28, (PGM_P)SPRITE_XY, (PGM_P)SPRITE_0, 0, 0, &head);
    addItem(Rx-curtainX, 28, (PGM_P)SPRITE_XY, (PGM_P)SPRITE_0, 0, 1, &head);
    DrawScreen(&head);
    freeList(&head);
    delay(100);
    curtainX += 1;
    if (curtainX % 2 == 0){
      i = generator(i);
    }
  }

  GetInput();
  curtainX -= 1;
  
  while (curtainX != -14-1){
    AddStage(&head);
    addItem(spriteX, 28, (PGM_P)pgm_read_word(&(POKEMON_ARR[4*randNumber + 2*i+1])), (PGM_P)pgm_read_word(&(POKEMON_ARR[4*randNumber + 2*i])), 0, 1, &head);
    addItem(curtainX, 28, (PGM_P)SPRITE_XY, (PGM_P)SPRITE_0, 0, 0, &head);
    addItem(Rx-curtainX, 28, (PGM_P)SPRITE_XY, (PGM_P)SPRITE_0, 0, 1, &head);
    DrawScreen(&head);
    freeList(&head);
    delay(100);
    curtainX -= 1;
    if (curtainX % 2 == 0){
      i = generator(i);
    }
  }

  display.setCursor(48 - (display.getPrintWidth("It's") / 2), 8 - (display.getFontHeight() / 2));
  display.print("It's");
  display.setCursor(48 - (display.getPrintWidth(pokename) / 2), 48 - (display.getFontHeight() / 2));
  display.print(pokename);
  GetInput();

  curtainX += 1;
  i = generator(i);
  while (spriteX != 102){
    spriteX += 2;
    AddStage(&head);
    addItem(spriteX, 28, (PGM_P)pgm_read_word(&(POKEMON_ARR[4*randNumber + 2*i+1])), (PGM_P)pgm_read_word(&(POKEMON_ARR[4*randNumber + 2*i])), 0, 1, &head);
    addItem(curtainX, 28, (PGM_P)SPRITE_XY, (PGM_P)SPRITE_0, 0, 0, &head);
    addItem(Rx-curtainX, 28, (PGM_P)SPRITE_XY, (PGM_P)SPRITE_0, 0, 1, &head);
    DrawScreen(&head);
    freeList(&head);
    i = generator(i);
    delay(200);
  }

}

unsigned char generator(unsigned char i){
  if (i == 1) return 0;
  else return 1;
}

void AddStage(ITEM_POINTER *head){
  unsigned char i = 0;
  while (i != 10){
    addItem(i*10 + 5, 59, (PGM_P)pgm_read_word(&(PLATFORM_ARR[2*(i%2)+1])), (PGM_P)pgm_read_word(&(PLATFORM_ARR[2*(i%2)])), 0, 0, head);
    i++;
  }
}

void GetInput(){
  while (1){
    if (display.getButtons(TSButtonUpperLeft) || display.getButtons(TSButtonLowerLeft) || display.getButtons(TSButtonUpperRight) || display.getButtons(TSButtonLowerRight)){
      break;
    }
  }
  delay(1000);
}
